## configs/default/linux-6.6/bsp_defconfig
```kconfig
# CONFIG_LOCALVERSION_AUTO is not set
CONFIG_SYSVIPC=y
CONFIG_NO_HZ=y
CONFIG_HIGH_RES_TIMERS=y
CONFIG_PREEMPT=y
CONFIG_IKCONFIG=y
CONFIG_IKCONFIG_PROC=y
CONFIG_CGROUPS=y
CONFIG_CGROUP_SCHED=y
CONFIG_NAMESPACES=y
# CONFIG_UTS_NS is not set
# CONFIG_PID_NS is not set
CONFIG_BLK_DEV_INITRD=y
# CONFIG_RD_BZIP2 is not set
# CONFIG_RD_LZMA is not set
# CONFIG_RD_XZ is not set
# CONFIG_RD_LZO is not set
# CONFIG_RD_LZ4 is not set
CONFIG_EXPERT=y
# CONFIG_SYSFS_SYSCALL is not set
# CONFIG_FHANDLE is not set
CONFIG_KALLSYMS_ALL=y
# CONFIG_RSEQ is not set
CONFIG_PROFILING=y
CONFIG_SCHED_MC=y
CONFIG_NR_CPUS=8
CONFIG_COMPAT=y
# CONFIG_EFI is not set
CONFIG_PM_USERSPACE_AUTOSLEEP=y
CONFIG_PM_WAKELOCKS=y
CONFIG_CPU_IDLE=y
CONFIG_ARM_PSCI_CPUIDLE=y
CONFIG_CPU_FREQ=y
CONFIG_CPU_FREQ_STAT=y
CONFIG_CPU_FREQ_GOV_POWERSAVE=y
CONFIG_CPU_FREQ_GOV_USERSPACE=y
CONFIG_CPU_FREQ_GOV_ONDEMAND=y
CONFIG_CPU_FREQ_GOV_CONSERVATIVE=y
CONFIG_MODULES=y
CONFIG_MODULE_UNLOAD=y
# CONFIG_IOSCHED_BFQ is not set
CONFIG_AW_BSP=y
CONFIG_AW_KERNEL_ORIGIN=y
CONFIG_ARCH_SUN60I=y
CONFIG_ARCH_SUN60IW2=y
CONFIG_AW_IC_BOARD=y
CONFIG_AW_SOC_NAME="A733"
# CONFIG_AW_UART is not set
CONFIG_AW_UART_NG=y
CONFIG_AW_SERIAL_CONSOLE=y
CONFIG_AW_TIMER_SUN50I=y
CONFIG_AW_DMA=y
CONFIG_AW_RTC=y
CONFIG_AW_RTC_REBOOT_FLAG=y
CONFIG_AW_RTC_POWEROFF_ALARM=y
CONFIG_AW_NSI=y
CONFIG_AW_WATCHDOG=y
CONFIG_AW_IOMMU=y
CONFIG_AW_IOMMU_V2=y
CONFIG_AW_MMC=y
CONFIG_AW_UFS=y
CONFIG_AW_MTD=y
CONFIG_AW_MTD_SUNXI_PARTS=y
CONFIG_AW_FB_CONSOLE=y
# CONFIG_AW_DISP2 is not set
CONFIG_AW_DI=m
CONFIG_SUNXI_DI_V3X=y
CONFIG_SUNXI_DI_SINGEL_FILE=y
CONFIG_AW_VIDEO_SUNXI_VIN=m
CONFIG_ACTUATOR=m
CONFIG_ACTUATOR_CN3927=m
# CONFIG_SENSOR_LIST is not set
CONFIG_SUPPORT_ISP_TDM=y
CONFIG_TDM_LBC_EN=y
CONFIG_D3D=y
CONFIG_D3D_LBC_MODE=y
# CONFIG_SAME_I2C is not set
CONFIG_SENSOR_GC030A=m
CONFIG_SENSOR_GC05A2=m
CONFIG_SENSOR_OV13850=m
CONFIG_AW_DRM=y
CONFIG_AW_DRM_LVDS=y
CONFIG_AW_DRM_DSI=y
CONFIG_PANEL_DSI_GENERAL=y
CONFIG_PANEL_LVDS_GENERAL=y
CONFIG_AW_DRM_PHY=y
CONFIG_AW_DRM_DSI_COMBOPHY=y
CONFIG_AW_DRM_PANFROST=m
CONFIG_AW_VIDEO_ENCODER_DECODER=m
CONFIG_AW_VIDEO_KERNEL_ENC=y
CONFIG_AW_VIDEO_KERNEL_DEC=y
# CONFIG_AW_VIDEO_DYNAMIC_DEBUG is not set
CONFIG_SND_SOC_AC101=y
CONFIG_SND_SOC_AC107=y
CONFIG_SND_SOC_SUNXI_OWA=y
CONFIG_SND_SOC_SUNXI_I2S=y
CONFIG_SND_SOC_SUNXI_CODEC_HDMI=m
CONFIG_SND_SOC_SUNXI_COMPONENTS=y
CONFIG_SND_SOC_SUNXI_PULSEAUDIO=y
CONFIG_SND_SOC_SUNXI_DEBUG=y
CONFIG_SND_SOC_AW87XXX=y
CONFIG_AW_SYS_INFO=y
CONFIG_AW_SMC=y
CONFIG_AW_SID=y
# CONFIG_AW_DRM_HEAP is not set
CONFIG_AW_PCIE_RC=y
CONFIG_AW_CADENCE_COMBOPHY=y
CONFIG_AW_GMAC=y
CONFIG_AW_GMAC_METADATA=y
CONFIG_AW_STMMAC_ETH=y
CONFIG_USB_SUNXI_DWC3=y
CONFIG_PHY_SUNXI_PLAT=y
CONFIG_USB_EHCI_HCD_SUNXI=y
CONFIG_USB_OHCI_HCD_SUNXI=y
CONFIG_USB_SUNXI_HCD=y
CONFIG_USB_SUNXI_HCI=y
CONFIG_USB_SUNXI_EHCI0=y
CONFIG_USB_SUNXI_EHCI1=y
CONFIG_USB_SUNXI_OHCI0=y
CONFIG_USB_SUNXI_OHCI1=y
CONFIG_USB_SUNXI_USB=y
CONFIG_USB_SUNXI_USB_MANAGER=m
CONFIG_USB_SUNXI_USB_DEBUG=m
CONFIG_USB_SUNXI_USB_ADB=m
CONFIG_USB_SUNXI_UDC0=y
CONFIG_USB_SUNXI_TYPEC=y
CONFIG_TYPEC_MUX_PS8743=y
CONFIG_TYPEC_MUX_SUNXI_PHY_SWITCHER=y
CONFIG_AW_TWI=y
CONFIG_AW_SPI_NG=y
CONFIG_AW_SPI_NG_ATOMIC_XFER=y
CONFIG_AW_SPI_SLAVETEST=m
CONFIG_AW_PWM=y
CONFIG_AW_GPADC=y
CONFIG_AW_INPUT_SENSORINIT=y
CONFIG_AW_INPUT_CTP=y
# CONFIG_TOUCHSCREEN_GSLX680NEW is not set
# CONFIG_TOUCHSCREEN_GT9XXNEW_TS is not set
CONFIG_AW_INPUT_SENSOR=y
CONFIG_AW_INPUT_MISC=y
CONFIG_AIC_WLAN_SUPPORT=y
CONFIG_AIC8800_WLAN_SUPPORT=m
CONFIG_AIC_LOADFW_SUPPORT=m
CONFIG_AIC_BTUSB_SUPPORT=m
CONFIG_AW_WAKEUPGEN=y
CONFIG_AW_SUN8I_NMI=y
CONFIG_AW_THERMAL=y
CONFIG_AW_PM_DOMAINS=y
CONFIG_NVMEM_AW_SID=y
CONFIG_AW_PCK600_DOMAINS=y
CONFIG_AW_POWER_DOMAIN_TEST=y
CONFIG_AW_MFD_AXP2101_I2C=y
CONFIG_AW_REGULATOR_AXP2101=y
CONFIG_AW_INPUT_AXP2101_PEK=y
CONFIG_AW_AXP515_POWER=y
CONFIG_AW_POWER_NOTIFIER=y
CONFIG_AW_AXP8191_TEMP_CTRL=y
CONFIG_AW_CPUFREQ_DT=y
CONFIG_ARM_AW_SUN50I_CPUFREQ_NVMEM=y
CONFIG_AW_DMC_DEVFREQ=y
CONFIG_AW_EVENT_DDR=y
CONFIG_AW_MSGBOX=y
CONFIG_AW_HWSPINLOCK=y
CONFIG_AW_NNA_VIP=y
CONFIG_NNA_VIP2=y
CONFIG_AW_CRASHDUMP=y
CONFIG_FAT_DEFAULT_UTF8=y
CONFIG_AW_RFKILL=y
CONFIG_AW_MACADDR_MGT=y
CONFIG_AW_GPU_TYPE="bxm"

# CONFIG_CORE_DUMP_DEFAULT_ELF_HEADERS is not set
# CONFIG_SLAB_MERGE_DEFAULT is not set
# CONFIG_COMPAT_BRK is not set
CONFIG_CMA=y
CONFIG_NET=y
CONFIG_PACKET=y
CONFIG_PACKET_DIAG=y
CONFIG_UNIX=y
CONFIG_INET=y
CONFIG_BT=y
CONFIG_BT_RFCOMM=y
CONFIG_BT_RFCOMM_TTY=y
CONFIG_BT_HCIUART=y
CONFIG_BT_HCIUART_H4=y
CONFIG_CFG80211=y
CONFIG_MAC80211=y
CONFIG_RFKILL=y
CONFIG_RFKILL_GPIO=y
CONFIG_PCI_ENDPOINT=y
CONFIG_DEVTMPFS=y
# CONFIG_ALLOW_DEV_COREDUMP is not set
# CONFIG_BLK_DEV is not set
CONFIG_MTD=y
CONFIG_MTD_OF_PARTS=m
CONFIG_MTD_BLOCK=y
CONFIG_BLK_DEV_NVME=m
CONFIG_NVME_TARGET=m
CONFIG_NVME_TARGET_PASSTHRU=y
CONFIG_NVME_TARGET_LOOP=m
CONFIG_EEPROM_AT24=y
CONFIG_SCSI=y
CONFIG_BLK_DEV_SD=y
CONFIG_SCSI_UFSHCD=y
CONFIG_SCSI_UFSHCD_PLATFORM=y
CONFIG_SCSI_UFS_BSG=y
CONFIG_INPUT_EVDEV=y
CONFIG_KEYBOARD_GPIO=y
# CONFIG_INPUT_MOUSE is not set
# CONFIG_SERIO_SERPORT is not set
# CONFIG_LEGACY_PTYS is not set
# CONFIG_HW_RANDOM is not set
CONFIG_I2C_GPIO=y
CONFIG_I2C_GPIO_FAULT_INJECTOR=y
CONFIG_SPI_SPIDEV=y
# CONFIG_PINCTRL_SUN8I_H3_R is not set
# CONFIG_PINCTRL_SUN50I_A64 is not set
# CONFIG_PINCTRL_SUN50I_A64_R is not set
# CONFIG_PINCTRL_SUN50I_A100 is not set
# CONFIG_PINCTRL_SUN50I_A100_R is not set
# CONFIG_PINCTRL_SUN50I_H5 is not set
# CONFIG_PINCTRL_SUN50I_H6 is not set
# CONFIG_PINCTRL_SUN50I_H6_R is not set
# CONFIG_PINCTRL_SUN50I_H616 is not set
# CONFIG_PINCTRL_SUN50I_H616_R is not set
CONFIG_SENSORS_PWM_FAN=y
CONFIG_THERMAL_STATISTICS=y
CONFIG_THERMAL_WRITABLE_TRIPS=y
CONFIG_THERMAL_GOV_FAIR_SHARE=y
CONFIG_THERMAL_GOV_BANG_BANG=y
CONFIG_THERMAL_GOV_USER_SPACE=y
CONFIG_CPU_THERMAL=y
CONFIG_CPU_IDLE_THERMAL=y
CONFIG_THERMAL_EMULATION=y
CONFIG_REGULATOR_FIXED_VOLTAGE=y
CONFIG_MEDIA_SUPPORT=y
CONFIG_VIDEO_V4L2_SUBDEV_API=y
CONFIG_MEDIA_USB_SUPPORT=y
CONFIG_USB_VIDEO_CLASS=m
CONFIG_DRM=y
CONFIG_FB=y
CONFIG_SOUND=y
CONFIG_SND=y
CONFIG_SND_USB_AUDIO=y
CONFIG_SND_SOC=y
CONFIG_USB=y
CONFIG_USB_ANNOUNCE_NEW_DEVICES=y
CONFIG_USB_OTG=y
CONFIG_USB_XHCI_HCD=y
CONFIG_USB_XHCI_DBGCAP=y
CONFIG_USB_EHCI_HCD=y
CONFIG_USB_EHCI_ROOT_HUB_TT=y
CONFIG_USB_EHCI_HCD_PLATFORM=y
CONFIG_USB_OHCI_HCD=y
CONFIG_USB_OHCI_HCD_PLATFORM=y
CONFIG_USB_ACM=y
CONFIG_USB_STORAGE=y
CONFIG_USB_STORAGE_REALTEK=y
CONFIG_USB_STORAGE_DATAFAB=y
CONFIG_USB_STORAGE_FREECOM=y
CONFIG_USB_STORAGE_ISD200=y
CONFIG_USB_STORAGE_USBAT=y
CONFIG_USB_STORAGE_SDDR09=y
CONFIG_USB_STORAGE_SDDR55=y
CONFIG_USB_STORAGE_JUMPSHOT=y
CONFIG_USB_STORAGE_ALAUDA=y
CONFIG_USB_STORAGE_ONETOUCH=y
CONFIG_USB_STORAGE_KARMA=y
CONFIG_USB_STORAGE_CYPRESS_ATACB=y
CONFIG_USB_STORAGE_ENE_UB6250=y
CONFIG_USB_UAS=y
CONFIG_USB_DWC3=y
CONFIG_USB_DWC3_HAPS=m
CONFIG_USB_DWC3_OF_SIMPLE=m
CONFIG_USB_DWC2=m
CONFIG_USB_DWC2_HOST=y
CONFIG_USB_SERIAL=y
CONFIG_USB_SERIAL_OPTION=y
CONFIG_USB_GADGET=y
CONFIG_USB_CONFIGFS=y
CONFIG_USB_CONFIGFS_SERIAL=y
CONFIG_USB_CONFIGFS_ACM=y
CONFIG_USB_CONFIGFS_NCM=y
CONFIG_USB_CONFIGFS_ECM=y
CONFIG_USB_CONFIGFS_RNDIS=y
CONFIG_USB_CONFIGFS_EEM=y
CONFIG_USB_CONFIGFS_MASS_STORAGE=y
CONFIG_USB_CONFIGFS_F_FS=y
CONFIG_USB_CONFIGFS_F_UAC2=y
CONFIG_USB_CONFIGFS_F_MIDI=y
CONFIG_USB_CONFIGFS_F_HID=y
CONFIG_TYPEC=y
CONFIG_USB_ROLE_SWITCH=y
CONFIG_TYPEC_TCPM=y
CONFIG_TYPEC_TCPCI=y
CONFIG_TYPEC_FUSB302=m
CONFIG_AW_TYPEC_HUSB311=y
CONFIG_TYPEC_ET7304=y
CONFIG_MMC=y
# CONFIG_PWRSEQ_EMMC is not set
# CONFIG_PWRSEQ_SIMPLE is not set
CONFIG_MMC_CQHCI=y
CONFIG_MMC_HSQ=y
CONFIG_SCSI_UFSHCD=y
CONFIG_SCSI_UFS_BSG=y
CONFIG_SCSI_UFSHCD_PLATFORM=y
CONFIG_LEDS_CLASS=y
CONFIG_NEW_LEDS=y
CONFIG_LEDS_GPIO=y
CONFIG_LEDS_TRIGGER_HEARTBEAT=y
CONFIG_LEDS_TRIGGER_DEFAULT_ON=y
CONFIG_RTC_DRV_HYM8563=m
CONFIG_DMABUF_HEAPS=y
CONFIG_DMABUF_SYSFS_STATS=y
CONFIG_DMABUF_HEAPS_SYSTEM=y
CONFIG_DMABUF_HEAPS_CMA=y
# CONFIG_SUNXI_CCU is not set
# CONFIG_ARM_ARCH_TIMER_EVTSTREAM is not set
# CONFIG_FSL_ERRATUM_A008585 is not set
CONFIG_DEVFREQ_GOV_PERFORMANCE=y
CONFIG_DEVFREQ_GOV_POWERSAVE=y
CONFIG_DEVFREQ_GOV_USERSPACE=y
CONFIG_DEVFREQ_GOV_PASSIVE=y
CONFIG_IIO=y
CONFIG_POWERCAP=y
CONFIG_IDLE_INJECT=y
CONFIG_ARM_DSU_PMU=y
CONFIG_TEE=y
CONFIG_OPTEE=y
CONFIG_EXT4_FS=y
# CONFIG_DNOTIFY is not set
CONFIG_MSDOS_FS=y
CONFIG_VFAT_FS=y
CONFIG_TMPFS=y
# CONFIG_MISC_FILESYSTEMS is not set
CONFIG_NLS_CODEPAGE_437=y
CONFIG_NLS_ISO8859_1=y
CONFIG_XZ_DEC=y
CONFIG_DMA_CMA=y
CONFIG_PRINTK_TIME=y
CONFIG_PRINTK_CALLER=y
CONFIG_MESSAGE_LOGLEVEL_DEFAULT=7
CONFIG_DYNAMIC_DEBUG_CORE=y
# CONFIG_DEBUG_MISC is not set
CONFIG_DEBUG_INFO_DWARF_TOOLCHAIN_DEFAULT=y
# CONFIG_SECTION_MISMATCH_WARN_ONLY is not set
CONFIG_MAGIC_SYSRQ=y
CONFIG_DEBUG_FS=y
CONFIG_PANIC_ON_OOPS=y
# CONFIG_FTRACE is not set
# CONFIG_STRICT_DEVMEM is not set
CONFIG_MAXIO_PHY=m

#
# Bluetooth device drivers
#
CONFIG_BT_HCIBTUSB=m
CONFIG_BT_HCIBTSDIO=m
CONFIG_BT_INTEL=m
CONFIG_BT_ATH3K=m
CONFIG_BT_MRVL=m
CONFIG_BT_MRVL_SDIO=m
CONFIG_BT_MTKSDIO=m
CONFIG_BT_MTKUART=m
CONFIG_BT_QCOMSMD=m
CONFIG_BT_BCM=m
CONFIG_BT_RTL=m
CONFIG_BT_QCA=m
CONFIG_BT_VIRTIO=m
CONFIG_BT_HCIUART_NOKIA=m
CONFIG_BT_HCIRSI=m

#
# DRM Drivers
#
CONFIG_AW_DRM_EDP=y
CONFIG_AW_DRM_TRILINEAR_EDP14=y
CONFIG_AW_DRM_EDP_CONTROLLER_USED=y
CONFIG_PANEL_EDP_GENERAL=y
CONFIG_TYPEC_DP_ALTMODE=y
CONFIG_AW_DRM_DP_HDCP=y
CONFIG_ATA=m
CONFIG_SATA_AHCI=m
CONFIG_SND_SOC_SUNXI_CODEC_AV=y
```
